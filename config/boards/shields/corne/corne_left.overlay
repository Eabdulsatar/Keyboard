/*
 * Copyright (c) 2020 Pete Johanson
 *
 * SPDX-License-Identifier: MIT
 */

#include "corne.dtsi"
#include <dt-bindings/zmk/rgb.h>

/ {
    chosen {
        zmk,underglow = &led_strip;
    };

    led_strip: ws2812 {
        compatible = "ws2812-gpio";
        chain-length = <36>;
        //color-mapping = <WS2812_COLOR_ORDER_GRB>;
        gpios = <&gpio0 29 GPIO_ACTIVE_HIGH>;
    };
};
